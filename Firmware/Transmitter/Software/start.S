// .section .text

// crtStart:
 

//  j _start
//  nop
//  nop
//  nop
//  nop
//  nop
//  nop
//  nop

.section .init

.global _start
_start:

 // copy the data segment to ram
__copy_data:
    la x1, __rodata_end       // counter in ROM
    la x2, __data_begin    // counter in RAM
    la x3, __data_end      // upper limit
    
__copy_data_1:
    beq x2, x3, __copy_data_2  // if we are done: jump to end
    nop
    lw x4, 0(x1)             // load from ROM
    nop
    sw x4, 0(x2)             // store to RAM
    nop
    addi x1, x1, 4           // increment counter ROM
    addi x2, x2, 4           // increment counter RAM
    j __copy_data_1          // repeat
__copy_data_2:

    
// Clears the .bss (zero initialized data) section:
.hidden clear_bss
clear_bss:
	la x1, __bss_begin
	la x2, __bss_end
	beq x1, x2, 2f		// Skip if there is no .bss section

1:
	sw x0, (x1)
    addi x1, x1, 4
	bne x1, x2, 1b

2:



    
	// clear all registers
  addi x1, zero, 0
	addi x2, zero, 0
	addi x3, zero, 0
	addi x4, zero, 0
	addi x5, zero, 0
	addi x6, zero, 0
	addi x7, zero, 0
	addi x8, zero, 0
	addi x9, zero, 0
	addi x10, zero, 0
	addi x11, zero, 0
	addi x12, zero, 0
	addi x13, zero, 0
	addi x14, zero, 0
	addi x15, zero, 0
	addi x16, zero, 0
	addi x17, zero, 0
	addi x18, zero, 0
	addi x19, zero, 0
	addi x20, zero, 0
	addi x21, zero, 0
	addi x22, zero, 0
	addi x23, zero, 0
	addi x24, zero, 0
	addi x25, zero, 0
	addi x26, zero, 0
	addi x27, zero, 0
	addi x28, zero, 0
	addi x29, zero, 0
	addi x30, zero, 0
	addi x31, zero, 0

init_stack:
	la sp, __stack_top

init_trap:
  li a0, 0x880     //880 enable timer + external interrupts
  csrw mie,a0
  li a0, 0x1808     //1808 enable interrupts
  csrw mstatus,a0
  la x5, trap_entry
  csrrw x0, mtvec, t0
  csrrsi x0, mtvec, 0x0 // Set vectored interrupt mode.
  

.hidden call_init_tiny
call_init_tiny:
    call init_tiny

.hidden call_main
call_main:  
	call main

.global  trap_entry
trap_entry:
  sw x1,  - 1*4(sp)
  sw x5,  - 2*4(sp)
  sw x6,  - 3*4(sp)
  sw x7,  - 4*4(sp)
  sw x10, - 5*4(sp)
  sw x11, - 6*4(sp)
  sw x12, - 7*4(sp)
  sw x13, - 8*4(sp)
  sw x14, - 9*4(sp)
  sw x15, -10*4(sp)
  sw x16, -11*4(sp)
  sw x17, -12*4(sp)
  sw x28, -13*4(sp)
  sw x29, -14*4(sp)
  sw x30, -15*4(sp)
  sw x31, -16*4(sp)
  addi sp,sp,-16*4
  call interruptCallback
  lw x1 , 15*4(sp)
  lw x5,  14*4(sp)
  lw x6,  13*4(sp)
  lw x7,  12*4(sp)
  lw x10, 11*4(sp)
  lw x11, 10*4(sp)
  lw x12,  9*4(sp)
  lw x13,  8*4(sp)
  lw x14,  7*4(sp)
  lw x15,  6*4(sp)
  lw x16,  5*4(sp)
  lw x17,  4*4(sp)
  lw x28,  3*4(sp)
  lw x29,  2*4(sp)
  lw x30,  1*4(sp)
  lw x31,  0*4(sp)
  addi sp,sp,16*4
  mret
